/**
 * Function / System Layer / Media Controls
 */

ZMK_LAYER(fnc,
// ╭───────────────┬───────────────┬───────────────┬───────────────┬───────────────┬───────────────╮   ╭───────────────┬───────────────┬───────────────┬───────────────┬───────────────┬───────────────╮
    ___             &kp F10         &kp F7          &kp F8          &kp F9          ___                 &kp C_VOL_UP    &kp C_PREV      ___             ___             ___             &kp C_POWER
// ├───────────────├───────────────┼───────────────┼───────────────┼───────────────┼───────────────┤   ├───────────────├───────────────┼───────────────┼───────────────┼───────────────┼───────────────┤
    ___             &kp F11         &kp F4          &kp F5          &kp F6          ___                 &kp C_VOL_DN    &kp C_NEXT      ___             ___             ___             ___
// ├───────────────├───────────────┼───────────────┼───────────────┼───────────────┼───────────────┤   ├───────────────├───────────────┼───────────────┼───────────────┼───────────────┼───────────────┤
    ___             &kp F12         &kp F1          &kp F2          &kp F3          ___                 &kp LC(DE_Z)    &kp LC(X)       &kp LC(INS)     &kp LS(INS)     &kp LC(DE_Y)    ___
// ╰───────────────┴───────────────┴───────────────┼───────────────┼───────────────┼───────────────┤   ├───────────────├───────────────┼───────────────┼───────────────┴───────────────┴───────────────╯
                                                    ___             ___             &to DEF             &to DEF         ___             ___   
//                                                 ╰───────────────┴───────────────┴───────────────╯   ╰───────────────┴───────────────┴───────────────╯
)