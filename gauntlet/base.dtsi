// ZMK Core Includes
#include <behaviors.dtsi>
#include <behaviors/num_word.dtsi> // Requires auto-layer module.
#include <dt-bindings/zmk/keys.h>
#ifdef CONFIG_WIRELESS
    #include <dt-bindings/zmk/bt.h>
    #include <dt-bindings/zmk/outputs.h>
    #include <dt-bindings/zmk/ext_power.h>
#endif

#include "zmk-helpers/helper.h"
#include "zmk-helpers/unicode-chars/german.dtsi"

// Layers
#define DEF 0
#define ALT 1
#define GME 2
#define GME_QZ 3
#define GME_NUM 4
#define NUM 5
#define FNR 6
#define SYS 7
#define MSE 8
#define XXX 9

// For gaming only left side needed
//#define HD2 7
//#define FNC 8
//#define NMR 9


#define _X_ &none
#define ___ &trans

// Meh key
#define MEH             LC(LS(LALT)) 

// Desktop and tab navigation shortcuts
#define D_LT            LC(LG(LEFT))
#define D_RT            LC(LG(RIGHT))
#define TAB_RT          LC(TAB)
#define TAB_LT          LC(LS(TAB))
#define MOV_W_LT        LG(LS(LEFT))
#define MOV_W_RT        LG(LS(RIGHT))
#define TEAMS_HR        LC(LS(K))
#define TEAMS_TV        LC(LS(O))
#define TEAMS_TA        LC(LS(M))
#define WIN_PREV        LS(TAB)

// Behaviors Constants
#define QUICK_TAP_MS 175

#include "macros.dtsi"
#include "behaviors.dtsi"
//#include "combos.dtsi"
//#include "leader.dtsi"
//#include "dances.dtsi"

// Alpha layer: uncomment desired, comment the others
//#include "../gauntlet/L0_ANYMAK.dtsi"
//#include "../gauntlet/L0_HD_PROMETHIUM.dtsi"
//#include "../gauntlet/L0_Infinity.dtsi"
#include "../gauntlet/L0_HD_Vib_Inf.dtsi"
#include "../gauntlet/L0_qwerty.dtsi"

// Other layers
#include "../gauntlet/L_GME_QWERTZ.dtsi"
#include "../gauntlet/L_GME_NUM.dtsi"
#include "../gauntlet/L_GME.dtsi"
#include "../gauntlet/L_NUM.dtsi"
#include "../gauntlet/L_FNR.dtsi"
#include "../gauntlet/L_SYS.dtsi"
#include "../gauntlet/L_MSE.dtsi"
#include "../gauntlet/L_XXX.dtsi"


/* vim: set ft=c tw=146: */
