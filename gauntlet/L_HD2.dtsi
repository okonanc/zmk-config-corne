/**
 *  HD2 Layer
 */

ZMK_LAYER(hd2,
// ╭───────────────┬───────────────┬───────────────┬───────────────┬───────────────┬───────────────╮   ╭───────────────┬───────────────┬───────────────┬───────────────┬───────────────┬───────────────╮
    &def_shield     &wp_flame       &wp_antitank    &wp_recrifle    &bp_gd_rover    &m1_reinforce       ___             ___             ___             ___             ___             ___             
// ├───────────────├───────────────┼───────────────┼───────────────┼───────────────┼───────────────┤   ├───────────────├───────────────┼───────────────┼───────────────┼───────────────┼───────────────┤
    &def_sen_tesla  &orb_laser      &def_sen_ems    &bp_shield      &off_eag_as     &m1_resupply        ___             ___             ___             ___             ___             ___             
// ├───────────────├───────────────┼───────────────┼───────────────┼───────────────┼───────────────┤   ├───────────────├───────────────┼───────────────┼───────────────┼───────────────┼───────────────┤
    ___             &orb_rcs        &wp_quasar_c    &wp_arc         &off_eag_500    &m1_hellbomb        ___             ___             ___             ___             ___             ___             
// ╰───────────────┴───────────────┴───────────────┼───────────────┼───────────────┼───────────────┤   ├───────────────├───────────────┼───────────────┼───────────────┴───────────────┴───────────────╯
                                                    ___             ___             ___                 ___             ___             ___   
//                                                 ╰───────────────┴───────────────┴───────────────╯   ╰───────────────┴───────────────┴───────────────╯
)