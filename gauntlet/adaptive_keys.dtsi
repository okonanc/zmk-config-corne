ZMK_ADAPTIVE_KEY(
    ak_magic,
        bindings = <&kp STAR>;
        akt_a_magic { trigger-keys = <A>; max-prior-idle-ms = <300>; bindings = <&kp O>;};
        akt_b_magic { trigger-keys = <B>; max-prior-idle-ms = <300>; bindings = <&kp E &kp F &kp O &kp R &kp E &kp SPACE>;};
        akt_c_magic { trigger-keys = <C>; max-prior-idle-ms = <300>; bindings = <&kp Y>;};
        akt_d_magic { trigger-keys = <D>; max-prior-idle-ms = <300>; bindings = <&kp Y>;};
        akt_e_magic { trigger-keys = <E>; max-prior-idle-ms = <300>; bindings = <&kp U>;};
//        akt_f_magic { trigger-keys = <F>; max-prior-idle-ms = <300>; bindings = <&kp Y>;};
        akt_g_magic { trigger-keys = <G>; max-prior-idle-ms = <300>; bindings = <&kp Y>;};
//        akt_h_magic { trigger-keys = <H>; max-prior-idle-ms = <300>; bindings = <&kp Y>;};
        akt_i_magic { trigger-keys = <I>; max-prior-idle-ms = <300>; bindings = <&kp I &kp O &kp N>;};
        akt_j_magic { trigger-keys = <J>; max-prior-idle-ms = <300>; bindings = <&kp U &kp S &kp T>;};
        akt_k_magic { trigger-keys = <K>; max-prior-idle-ms = <300>; bindings = <&kp S>;};
        akt_l_magic { trigger-keys = <L>; max-prior-idle-ms = <300>; bindings = <&kp K>;};
        akt_m_magic { trigger-keys = <M>; max-prior-idle-ms = <300>; bindings = <&kp E &kp N &kp T>;};
        akt_n_magic { trigger-keys = <N>; max-prior-idle-ms = <300>; bindings = <&kp I &kp O &kp N>;};
        akt_o_magic { trigger-keys = <O>; max-prior-idle-ms = <300>; bindings = <&kp A>;};
        akt_p_magic { trigger-keys = <P>; max-prior-idle-ms = <300>; bindings = <&kp Y>;};
        akt_q_magic { trigger-keys = <Q>; max-prior-idle-ms = <300>; bindings = <&kp U>;};
        akt_r_magic { trigger-keys = <R>; max-prior-idle-ms = <300>; bindings = <&kp L>;};
        akt_s_magic { trigger-keys = <S>; max-prior-idle-ms = <300>; bindings = <&kp K>;};
        akt_t_magic { trigger-keys = <T>; max-prior-idle-ms = <300>; bindings = <&kp M &kp E &kp N &kp T>;};
        akt_u_magic { trigger-keys = <U>; max-prior-idle-ms = <300>; bindings = <&kp E>;};
        akt_v_magic { trigger-keys = <V>; max-prior-idle-ms = <300>; bindings = <&kp E &kp R>;};
        akt_w_magic { trigger-keys = <W>; max-prior-idle-ms = <300>; bindings = <&kp H &kp I &kp C &kp H>;};
        akt_x_magic { trigger-keys = <X>; max-prior-idle-ms = <300>; bindings = <&kp E &kp S>;};
        akt_y_magic { trigger-keys = <X>; max-prior-idle-ms = <300>; bindings = <&kp P>;};
//        akt_z_magic { trigger-keys = <Z>; max-prior-idle-ms = <300>; bindings = <&kp Y>;};
        akt_space_magic { trigger-keys = <SPACE>; max-prior-idle-ms = <300>; bindings = <&kp T &kp H>;};
)
