    / {
  behaviors {
    /*
     - tap: &kp 
     - tap x 2: &csl
     */
    /omit-if-no-ref/ td_kp_csl: td_kp_csl {
      label = "DANCE_KP_CSL";
      compatible = "zmk,behavior-tap-dance";
      tapping-term-ms = <TAPPING_TERM_MS>;
      bindings = <&kp>, <&csl>;
      #binding-cells = <2>;
    };

    /*
     - tap: &kp COMMA
     - tap x 2: &kp DOT
     
    /omit-if-no-ref/ comma_dance: comma_dance {
      label = "COMMA_DANCE";
      compatible = "zmk,behavior-tap-dance";
      tapping-term-ms = <TAPPING_TERM_MS>;
      bindings = <&kp COMMA>, <&kp DOT>;
      #binding-cells = <0>;
    };
    */
    
  };
};