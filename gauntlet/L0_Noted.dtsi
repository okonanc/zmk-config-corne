/**
 * Alpha Layer - NOTED
 */

#define HMR_ALT_DOT &hmr_alt_dot RALT 0

ZMK_LAYER(def,
// ╭───────────────┬───────────────┬───────────────┬───────────────┬───────────────┬───────────────╮   ╭───────────────┬───────────────┬───────────────┬───────────────┬───────────────┬───────────────╮
    &kp ESC         &kp Y           &kp U           &kp A           &kp Q           &kp P               &kp B           &kp M           &kp L           &kp F           &kp J           &kp K_CANCEL
// ├───────────────├───────────────┼───────────────┼───────────────┼───────────────┼───────────────┤   ├───────────────├───────────────┼───────────────┼───────────────┼───────────────┼───────────────┤
    &bs_del         &hml LCMD C     &hml LALT S     &hml LCTRL I    &hml LSHFT E    &hml MEH O          &hmr MEH D      &hmr RSHFT T    &hmr LCTRL N    &hmr LALT R     &hmr LCMD H     &kp ENTER
// ├───────────────├───────────────┼───────────────┼───────────────┼───────────────┼───────────────┤   ├───────────────├───────────────┼───────────────┼───────────────┼───────────────┼───────────────┤
    &sl FNC         &kp V           &hml RALT X     &intl_ue        &intl_ae        &intl_oe            &kp W           &kp G           &comma_morph    HMR_ALT_DOT     &kp K           &sl FNC
// ╰───────────────┴───────────────┴───────────────┼───────────────┼───────────────┼───────────────┤   ├───────────────├───────────────┼───────────────┼───────────────┴───────────────┴───────────────╯
                                                    &lt SYM TAB     &lt_spc FNC 0   &lt NUM RET         SMART_NUM       MAGIC_SHIFT     &mo SYM
//                                                 ╰───────────────┴───────────────┴───────────────╯   ╰───────────────┴───────────────┴───────────────╯
)
