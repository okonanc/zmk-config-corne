/**
 * Alpha Layer - PUQ
 */

ZMK_LAYER(puq,
// ╭───────────────┬───────────────┬───────────────┬───────────────┬───────────────┬───────────────╮   ╭───────────────┬───────────────┬───────────────┬───────────────┬───────────────┬───────────────╮
    &kp ESC         &kp P           &kp U           &kp DQT         &kp COMMA       &kp Q               &kp G           &kp C           &kp L           &kp M           &kp F           &kp K_CANCEL
// ├───────────────├───────────────┼───────────────┼───────────────┼───────────────┼───────────────┤   ├───────────────├───────────────┼───────────────┼───────────────┼───────────────┼───────────────┤
    &bs_del         &hml LCMD H     &hml LALT I     &hml LCTRL E    &hml LSHFT A    &hml MEH O          &hml MEH D      &hmr RSHFT T    &hmr LCTRL R    &hmr LALT N     &hmr LCMD S     &kp ENTER
// ├───────────────├───────────────┼───────────────┼───────────────┼───────────────┼───────────────┤   ├───────────────├───────────────┼───────────────┼───────────────┼───────────────┼───────────────┤
    &sl FNR         &kp K           &hml RALT Y     &dot_morph      &ndk_sqt        &kp X               &kp J           &kp V           &kp W           &hmr RALT B     &kp Z           &sl FNR
// ╰───────────────┴───────────────┴───────────────┼───────────────┼───────────────┼───────────────┤   ├───────────────├───────────────┼───────────────┼───────────────┴───────────────┴───────────────╯
                                                    &lt SYM TAB     &lt_spc FNR 0   &lt NUM RET         SMART_NUM       MAGIC_SHIFT     &mo SYM
//                                                 ╰───────────────┴───────────────┴───────────────╯   ╰───────────────┴───────────────┴───────────────╯
)
