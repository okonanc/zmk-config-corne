/**
 * Alpha Layer - QWERTZ
 */

ZMK_LAYER(def,
// ╭───────────────┬───────────────┬───────────────┬───────────────┬───────────────┬───────────────╮   ╭───────────────┬───────────────┬───────────────┬───────────────┬───────────────┬───────────────╮
    &kp ESC         &kp Q           &kp W           &kp E           &kp R           &kp T               &kp Y           &kp U           &kp I           &kp O           &sdq            &kp K_CANCEL
// ├───────────────├───────────────┼───────────────┼───────────────┼───────────────┼───────────────┤   ├───────────────├───────────────┼───────────────┼───────────────┼───────────────┼───────────────┤
    &bkspc_del      &hml LCMD A     &hml LALT S     &hml LCTRL D    &hml LSHFT F    &hml MEH G          &hmr MEH H      &hmr RSHFT J    &hmr LCTRL K    &hmr RALT L     &hmr LCMD P     &kp ENTER
// ├───────────────├───────────────┼───────────────┼───────────────┼───────────────┼───────────────┤   ├───────────────├───────────────┼───────────────┼───────────────┼───────────────┼───────────────┤
    &sl FNC         &kp Z           &hml RALT X     &kp C           &kp V           &kp B               &kp N           &kp M           &kp COMMA       &hmr LALT DOT   &qexcl          &sl FNC
// ╰───────────────┴───────────────┴───────────────┼───────────────┼───────────────┼───────────────┤   ├───────────────├───────────────┼───────────────┼───────────────┴───────────────┴───────────────╯
                                                    &lt SYM TAB     &lt_spc FNC 0   &lt NUM RET         SMART_NUM       &smart_shift    &mo SYM
//                                                 ╰───────────────┴───────────────┴───────────────╯   ╰───────────────┴───────────────┴───────────────╯
)
