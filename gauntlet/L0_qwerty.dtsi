/**
 * Alpha Layer - QWERTY
 */

#define HMR_ALT_DOT &hmr_alt_dot RALT 0

ZMK_LAYER(def,
// ╭───────────────┬───────────────┬───────────────┬───────────────┬───────────────┬───────────────╮   ╭───────────────┬───────────────┬───────────────┬───────────────┬───────────────┬───────────────╮
    &kp ESC         &kp Q           &kp W           &kp E           &kp R           &kp T               &kp Y           &kp U           &kp I           &kp O           &kp SQT         &kp K_CANCEL
// ├───────────────├───────────────┼───────────────┼───────────────┼───────────────┼───────────────┤   ├───────────────├───────────────┼───────────────┼───────────────┼───────────────┼───────────────┤
    &bs_del         &hml LCMD A     &hml LALT S     &hml LCTRL D    &hml LSHFT F    &kp G               &kp H           &hmr RSHFT J    &hmr LCTRL K    &hmr LALT L     &hmr LCMD P     &kp ENTER
// ├───────────────├───────────────┼───────────────┼───────────────┼───────────────┼───────────────┤   ├───────────────├───────────────┼───────────────┼───────────────┼───────────────┼───────────────┤
    &sl SYS         &kp Z           &hml RALT X     &kp C           &kp V           &kp B               &kp N           &kp M           &comma_morph    HMR_ALT_DOT     &qexcl          &sl SYS
// ╰───────────────┴───────────────┴───────────────┼───────────────┼───────────────┼───────────────┤   ├───────────────├───────────────┼───────────────┼───────────────┴───────────────┴───────────────╯
                                                    &lt SYM TAB     &lt_spc FNR 0   &lt NUM RET         SMART_NUM       MAGIC_SHIFT     &mo SYS
//                                                 ╰───────────────┴───────────────┴───────────────╯   ╰───────────────┴───────────────┴───────────────╯
)
