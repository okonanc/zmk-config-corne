/**
 * Steno Layer
 */
&lt {  // layer-tap config
    flavor = "balanced";
    tapping-term-ms = <300>;
    quick-tap-ms = <250>;
};

ZMK_LAYER(steno,
// ╭───────────────┬───────────────┬───────────────┬───────────────┬───────────────┬───────────────╮   ╭───────────────┬───────────────┬───────────────┬───────────────┬───────────────┬───────────────╮
    XXX             &kp N1          &kp N2          &kp N3          &kp N4          &kp N5              &kp N6          &kp N7          &kp N8          &kp N9          &kp N0          XXX
// ├───────────────├───────────────┼───────────────┼───────────────┼───────────────┼───────────────┤   ├───────────────├───────────────┼───────────────┼───────────────┼───────────────┼───────────────┤
    XXX             &kp S           &kp T           &kp P           &kp H           &kp STAR            &kp F           &kp P           &kp L           &kp T           &kp D           XXX
// ├───────────────├───────────────┼───────────────┼───────────────┼───────────────┼───────────────┤   ├───────────────├───────────────┼───────────────┼───────────────┼───────────────┼───────────────┤
    XXX             &kp S           &kp K           &kp W           &kp R           &kp STAR            &kp R           &kp B           &kp G           &kp S           &kp Z           XXX
// ╰───────────────┴───────────────┴───────────────┼───────────────┼───────────────┼───────────────┤   ├───────────────├───────────────┼───────────────┼───────────────┴───────────────┴───────────────╯
                                                    XXX             &kp A           &kp O               &kp E           &kp U           XXX
//                                                 ╰───────────────┴───────────────┴───────────────╯   ╰───────────────┴───────────────┴───────────────╯
)
