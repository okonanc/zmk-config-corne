/**
 * Numbers and Navigation Layer
 */

ZMK_LAYER(nmr,
// ╭───────────────┬───────────────┬───────────────┬───────────────┬───────────────┬───────────────╮   ╭───────────────┬───────────────┬───────────────┬───────────────┬───────────────┬───────────────╮
    ___             &kp PG_UP       NAV_BSPC        NAV_UP          NAV_DEL         &kp WIN_PREV        ___             &kp N7          &kp N8          &kp N9          ___             ___   
// ├───────────────├───────────────┼───────────────┼───────────────┼───────────────┼───────────────┤   ├───────────────├───────────────┼───────────────┼───────────────┼───────────────┼───────────────┤
    ___             &kp PG_DN       NAV_LEFT        NAV_DOWN        NAV_RIGHT       &swapper            &sk MEH         &hmr RSHFT N4   &hmr LCTRL N5   &hmr LALT N6    &sk LCMD        ___ 
// ├───────────────├───────────────┼───────────────┼───────────────┼───────────────┼───────────────┤   ├───────────────├───────────────┼───────────────┼───────────────┼───────────────┼───────────────┤
    ___             &kp TAB_LT      &kp MOV_W_LT    &kp LA(F4)      &kp MOV_W_RT    &kp TAB_RT          ___             &kp N1          &kp N2          &mt LALT N3     ___             ___   
// ╰───────────────┴───────────────┴───────────────┼───────────────┼───────────────┼───────────────┤   ├───────────────├───────────────┼───────────────┼───────────────┴───────────────┴───────────────╯
                                                    ___             ___             ___                 CANCEL          &kp N0          ___
//                                                 ╰───────────────┴───────────────┴───────────────╯   ╰───────────────┴───────────────┴───────────────╯
)
