/**
 * Function / System Layer / Media Controls
 */

ZMK_LAYER(fnr,
// ╭───────────────┬───────────────┬───────────────┬───────────────┬───────────────┬───────────────╮   ╭───────────────┬───────────────┬───────────────┬───────────────┬───────────────┬───────────────╮
    ___             &kp F12         &kp F7          &kp F8          &kp F9          ___                 ___             ___             ___             ___             ___             &kp C_POWER
// ├───────────────├───────────────┼───────────────┼───────────────┼───────────────┼───────────────┤   ├───────────────├───────────────┼───────────────┼───────────────┼───────────────┼───────────────┤
    ___             &hml LGUI F11   &hml LALT F4    &hml LCTRL F5   &hml LSHFT F6   ___                 MED_NEXT        VOL_DOWN        VOL_UP          MED_PREV        ___             ___
// ├───────────────├───────────────┼───────────────┼───────────────┼───────────────┼───────────────┤   ├───────────────├───────────────┼───────────────┼───────────────┼───────────────┼───────────────┤
    ___             &kp F10         &hml RALT F1    &kp F2          &kp F3          ___                 DSK_NEXT        PIN_APP         PIN_WIN         DSK_PREV        ___             ___
// ╰───────────────┴───────────────┴───────────────┼───────────────┼───────────────┼───────────────┤   ├───────────────├───────────────┼───────────────┼───────────────┴───────────────┴───────────────╯
                                                    ___             ___             ___                 &kp C_MUTE      &kp C_PP        ___   
//                                                 ╰───────────────┴───────────────┴───────────────╯   ╰───────────────┴───────────────┴───────────────╯
)
