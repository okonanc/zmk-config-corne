/**
 * Gaming Layer
 */
&lt {  // layer-tap config
    flavor = "balanced";
    flavor = "tap-preferred";
    tapping-term-ms = <300>;
    quick-tap-ms = <250>;
};

ZMK_BASE_LAYER(Gme,
// ╭───────────────┬───────────────┬───────────────┬───────────────┬───────────────┬───────────────╮   ╭───────────────┬───────────────┬───────────────┬───────────────┬───────────────┬───────────────╮
    &kp T           &kp ESC         &kp Q           &kp W           &kp E           &kp R          ,    &kp Z           &kp U           &kp I           &kp O           &kp SQT         CANCEL         ,
// ├───────────────├───────────────┼───────────────┼───────────────┼───────────────┼───────────────┤   ├───────────────├───────────────┼───────────────┼───────────────┼───────────────┼───────────────┤
    &kp G           &kp TAB         &kp A           &kp S           &kp D           &kp F          ,    &kp H           &kp J           &kp K           &kp L           &kp P           &kp ENTER      ,
// ├───────────────├───────────────┼───────────────┼───────────────┼───────────────┼───────────────┤   ├───────────────├───────────────┼───────────────┼───────────────┼───────────────┼───────────────┤
    &kp B           &kp LCTRL       &kp Y           &kp X           &kp C           &kp V          ,    &kp N           &kp M           &kp COMMA       &kp DOT         &qexcl          &to DEF        ,
// ╰───────────────┴───────────────┴───────────────┼───────────────┼───────────────┼───────────────┤   ├───────────────├───────────────┼───────────────┼───────────────┴───────────────┴───────────────╯
                                                    &kp LALT        &lt GME_NUM SPACE &kp LSHFT    ,    SMART_NUM       MAGIC_SHIFT     &kp RET
//                                                 ╰───────────────┴───────────────┴───────────────╯   ╰───────────────┴───────────────┴───────────────╯
)
