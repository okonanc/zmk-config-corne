/**
 * Gaming Layer
 */
&lt {  // layer-tap config
    /* flavor = "balanced"; */
    flavor = "tap-preferred";
    tapping-term-ms = <300>;
    quick-tap-ms = <250>;
};

ZMK_BASE_LAYER(Gme-qz,
// ╭───────────────┬───────────────┬───────────────┬───────────────┬───────────────┬───────────────╮   ╭───────────────┬───────────────┬───────────────┬───────────────┬───────────────┬───────────────╮
    &kp ESC         &kp Q           &kp W           &kp E           &kp R           &kp T          ,    &kp Z           &kp U           &kp I           &kp O           &kp SQT         CANCEL         ,
// ├───────────────├───────────────┼───────────────┼───────────────┼───────────────┼───────────────┤   ├───────────────├───────────────┼───────────────┼───────────────┼───────────────┼───────────────┤
    &kp TAB         &kp A           &kp S           &kp D           &kp F           &kp G          ,    &kp H           &kp J           &kp K           &kp L           &kp P           &kp ENTER      ,
// ├───────────────├───────────────┼───────────────┼───────────────┼───────────────┼───────────────┤   ├───────────────├───────────────┼───────────────┼───────────────┼───────────────┼───────────────┤
    &to GME         &kp Y           &kp X           &kp C           &kp V           &kp B          ,    &kp N           &kp M           &kp COMMA       &kp DOT         &qexcl          &to DEF        ,
// ╰───────────────┴───────────────┴───────────────┼───────────────┼───────────────┼───────────────┤   ├───────────────├───────────────┼───────────────┼───────────────┴───────────────┴───────────────╯
                                                    &kp LCMD        &lt_spc FNR 0   &kp RET        ,    SMART_NUM       MAGIC_SHIFT     &kp RET
//                                                 ╰───────────────┴───────────────┴───────────────╯   ╰───────────────┴───────────────┴───────────────╯
)
