/**
 * Alpha Layer - QWERTY
 */

#define HMR_ALT_DOT &hmr_alt_dot RALT 0
/{
    behaviors {
        sensor_vol: sensor_vol {
            compatible =  "zmk,behavior-sensor-rotate";
            #sensor-bindings-cells = <0>;
            bindings = <&vol_up_morph>, <&vol_down_morph>;
        };
        
        sensor_nav: sensor_nav {
            compatible =  "zmk,behavior-sensor-rotate";
            #sensor-bindings-cells = <0>;
            bindings = <&pg_up_morph>, <&pg_dn_morph>;
        };
    };
};
ZMK_BASE_LAYER(Qwerty,
//                 ╭───────────────┬───────────────┬───────────────┬───────────────┬───────────────╮                                   ╭───────────────┬───────────────┬───────────────┬───────────────┬───────────────╮
                    &kp Q           &kp W           &kp E           &kp R           &kp T          ,                                    &kp Y           &kp U           &kp I           &kp O           &kp SQT        ,
// ╭───────────────┼───────────────┼───────────────┼───────────────┼───────────────┼───────────────┤                                   ├───────────────├───────────────┼───────────────┼───────────────┼───────────────┼───────────────╮
    &bs_del         &hml LCMD A     &hml LALT S     &hml LCTRL D    &hml LSHFT F    &hml MEH G     ,                                    &hmr MEH H      &hmr RSHFT J    &hmr LCTRL K    &hmr LALT L     &hmr LCMD P     &kp RET        ,
// ├───────────────┼───────────────┼───────────────┼───────────────┼───────────────┼───────────────┼───────────────╮   ╭───────────────┼───────────────┼───────────────┼───────────────┼───────────────┼───────────────┼───────────────┤
    &esc_morph      &kp Z           &kp X           &kp C           &kp V           &kp B           &mute_morph    ,    &home_morph        &kp N           &kp M           &comma_morph    HMR_ALT_DOT     &slash_morph    &kp BSLH       ,
// ╰───────────────┴───────────────┴───────────────┼───────────────┼───────────────┼───────────────┼───────────────┤   ├───────────────┼───────────────┼───────────────┼───────────────┼───────────────┴───────────────┴───────────────╯
                                                    &lt SYS TAB     &lt_spc FNR 0   &kp RET         &mo NUM        ,    &mo SYS         SMART_NUM       MAGIC_SHIFT     &bs_del        ,
//                                                 ╰───────────────┴───────────────┴───────────────┴───────────────╯   ╰───────────────┴───────────────┴───────────────┴───────────────╯
&sensor_vol &sensor_nav 
)
