
//                               █         █    █            ▄▄▄▀▀▀▀▀▀▄▄▄        █▀▀▀▀▀▀▀▀▀▀█
//                               █        █     █          ▄▀            ▀▄      █          █
//                               █       █      █        ▄▀                ▀▄    █          █
//                               █      █       █        █                  █    █          █
//                               █     █        █       █                    █   █          █
//                               █    █         █       █                    █   █▄▄▄▄▄▄▄▄▄▄█
//                               █   █ █        █       █                    █   █      █
//                               █  █   █       █        █                  █    █       █
//                               █ █     █      █        ▀▄                ▄▀    █        █
//                               ██       █     █          ▀▄            ▄▀      █         █
//                               █         █    █▄▄▄▄▄▄▄▄    ▀▀▀▄▄▄▄▄▄▀▀▀        █          █
//
// ▄▄▄▄▄▄▄▄▄▄▄▄▄▄▄▄▄▄▄▄▄▄▄▄▄▄▄▄▄▄▄▄▄▄▄▄▄▄▄▄▄▄▄▄▄▄▄▄▄▄▄▄▄▄▄▄▄▄▄▄▄▄▄▄▄▄▄▄▄▄▄▄▄▄▄▄▄▄▄▄▄▄▄▄▄▄▄▄▄▄▄▄▄▄▄▄▄▄▄▄▄▄▄▄▄▄▄▄▄▄▄▄▄▄▄▄▄▄▄▄▄▄▄▄▄
       
#include <behaviors.dtsi>
#include <behaviors/num_word.dtsi> // Requires auto-layer module.
#include <dt-bindings/zmk/rgb.h>
#include <dt-bindings/zmk/keys.h>
#include <dt-bindings/zmk/bt.h>
#include <dt-bindings/zmk/outputs.h>
#include <dt-bindings/zmk/ext_power.h>

#include <zmk-helpers/helper.h>
#include <zmk-helpers/key-labels/klor.h>
#include <zmk-helpers/unicode-chars/german.dtsi>


// Layers
// #define ALT 1
#define DEF 0
#define GME 1
#define GME_QZ 2
#define GME_NUM 3
#define GME_FNR 4
#define NUM 5
#define FNR 6
#define SYS 7
/* #define MSE 9 */
/* #define BASE   0 */
/* #define LOWER  1 */
/* #define RAISE  2 */
/* #define ADJUST 3 */

#define _X_ &none
#define ___ &trans

// Meh key
#define MEH             LC(LS(LALT)) 

// Desktop and tab navigation shortcuts
#define D_LT            LC(LG(LEFT))
#define D_RT            LC(LG(RIGHT))
#define TAB_RT          LC(TAB)
#define TAB_LT          LC(LS(TAB))
#define MOV_W_LT        LG(LS(LEFT))
#define MOV_W_RT        LG(LS(RIGHT))
#define TEAMS_HR        LC(LS(K))
#define TEAMS_TV        LC(LS(O))
#define TEAMS_TA        LC(LS(M))
#define WIN_PREV        LS(TAB)

// Behaviors Constants
#define QUICK_TAP_MS 175

#include "./macros.dtsi"
#include "./behaviors.dtsi"

#include "./L0_qwerty.dtsi"

// Other l./ayers
#include "./L_GME.dtsi"
#include "./L_GME_QWERTZ.dtsi"
#include "./L_GME_NUM.dtsi"
#include "./L_GME_FNR.dtsi"
#include "./L_NUM.dtsi"
#include "./L_FNR.dtsi"
#include "./L_SYS.dtsi"

/* vim: set ft=c tw=146: */
