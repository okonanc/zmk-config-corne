/**
 * Gaming Layer
 */
&lt {  // layer-tap config
    /* flavor = "balanced"; */
    flavor = "tap-preferred";
    tapping-term-ms = <300>;
    quick-tap-ms = <250>;
};

/* ZMK_BASE_LAYER(Gme-qz, */
/* // ╭───────────────┬───────────────┬───────────────┬───────────────┬───────────────┬───────────────╮   ╭───────────────┬───────────────┬───────────────┬───────────────┬───────────────┬───────────────╮ */
/*     &kp ESC         &kp Q           &kp W           &kp E           &kp R           &kp T          ,    &kp Z           &kp U           &kp I           &kp O           &kp SQT         CANCEL         , */
/* // ├───────────────├───────────────┼───────────────┼───────────────┼───────────────┼───────────────┤   ├───────────────├───────────────┼───────────────┼───────────────┼───────────────┼───────────────┤ */
/*     &bs_del         &kp A           &kp S           &kp D           &kp F           &kp G          ,    &kp H           &kp J           &kp K           &kp L           &kp P           &kp ENTER      , */
/* // ├───────────────├───────────────┼───────────────┼───────────────┼───────────────┼───────────────┤   ├───────────────├───────────────┼───────────────┼───────────────┼───────────────┼───────────────┤ */
/*     &to GME         &kp Y           &kp X           &kp C           &kp V           &kp B          ,    &kp N           &kp M           &kp COMMA       &kp DOT         &slash_morph    &to DEF        , */
/* // ╰───────────────┴───────────────┴───────────────┼───────────────┼───────────────┼───────────────┤   ├───────────────├───────────────┼───────────────┼───────────────┴───────────────┴───────────────╯ */
/*                                                     &kp LCMD        &lt_spc FNR 0   &kp RET        ,    SMART_NUM       MAGIC_SHIFT     &kp RET */
/* //                                                 ╰───────────────┴───────────────┴───────────────╯   ╰───────────────┴───────────────┴───────────────╯ */
/* ) */

// ┌───────────────────────────────────────────────────────────┐
label= "GME-QZ"                                                  ;
// └───────────────────────────────────────────────────────────┘
 bindings = <
//                 ╭───────────────┬───────────────┬───────────────┬───────────────┬───────────────╮                                   ╭───────────────┬───────────────┬───────────────┬───────────────┬───────────────╮
                    &kp Q           &kp W           &kp E           &kp R           &kp T                                               &kp Y           &kp U           &kp I           &kp O           &kp SQT
// ╭───────────────┼───────────────┼───────────────┼───────────────┼───────────────┼───────────────┤                                   ├───────────────├───────────────┼───────────────┼───────────────┼───────────────┼───────────────╮
    &bs_del         &kp A           &kp S           &kp D           &kp F           &kp G                                               &kp H           &kp J           &kp K           &kp L           &kp P           &kp ENTER
// ├───────────────┼───────────────┼───────────────┼───────────────┼───────────────┼───────────────┼───────────────╮   ╭───────────────┼───────────────┼───────────────┼───────────────┼───────────────┼───────────────┼───────────────┤
    &kp ESC         &kp Z           &kp X           &kp C           &kp V           &kp B           &kp C_MUTE          &kp HOME        &kp N           &kp M           &kp COMMA       &kp DOT         &slash_morph    &to DEF
// ╰───────────────┴───────────────┴───────────────┼───────────────┼───────────────┼───────────────┼───────────────┤   ├───────────────┼───────────────┼───────────────┼───────────────┼───────────────┴───────────────┴───────────────╯
                                                    &lt SYS TAB     &lt_spc FNR 0   &kp RET         &mo NUM             &mo SYS         SMART_NUM       MAGIC_SHIFT     &bs_del
//                                                 ╰───────────────┴───────────────┴───────────────┴───────────────╯   ╰───────────────┴───────────────┴───────────────┴───────────────╯
                        >;
                        sensor-bindings = <&inc_dec_kp C_VOL_UP C_VOL_DN &inc_dec_kp PG_UP PG_DN>;
                };
