/*
 * Copyright (c) 2020 The ZMK Contributors
 *
 * SPDX-License-Identifier: MIT
 */

#define MOUSE_KEYS
#define CONFIG_WIRELESS

/* #include <zmk-helpers/key-labels/42.h> */

#include "./gauntlet/base.dtsi"


