/**
 *  Mouse Layer
 */

// Settings tuned for 3840 x 2160 display resolution

#include <dt-bindings/zmk/pointing.h>
#include <input/processors.dtsi>
#include <zephyr/dt-bindings/input/input-event-codes.h>

ZMK_BASE_LAYER(Mbp,
// ╭───────────────┬───────────────┬───────────────┬───────────────┬───────────────┬───────────────╮   ╭───────────────┬───────────────┬───────────────┬───────────────┬───────────────┬───────────────╮
    ___             ___             ---             ---             ---             ___            ,    ___             ---             ---             ___             ___             ___            ,
// ├───────────────┼───────────────├───────────────┼───────────────┼───────────────┼───────────────┤   ├───────────────├───────────────┼───────────────┼───────────────┼───────────────┼───────────────┤
    ___             ___             ---             &mkp MB4        &mkp MB5        ___            ,    ---             &mkp MB5        &mkp MB4        ---             ___             ___            ,
// ├───────────────┼───────────────├───────────────┼───────────────┼───────────────┼───────────────┤   ├───────────────├───────────────┼───────────────┼───────────────┼───────────────┼───────────────┤
    ___             ___             ---             ---             ---             ___            ,    ___             ---             ---             ___             ___             ___            ,
// ╰───────────────┴───────────────┴───────────────┼───────────────┼───────────────┼───────────────┤   ├───────────────├───────────────┼───────────────┼───────────────┴───────────────┴───────────────╯
                                                    &mkp RCLK       &mkp MCLK       &mkp LCLK      ,    &mkp LCLK       &mkp MCLK       &mkp RCLK       
//                                                 ╰───────────────┴───────────────┴───────────────╯   ╰───────────────┴───────────────┴───────────────╯
)

/* vim: set ft=c tw=146: */
