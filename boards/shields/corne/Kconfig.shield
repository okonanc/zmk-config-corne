## boards/shields/corne/Kconfig.shield
```kconfig
# Copyright (c) 2020 Pete Johanson
# SPDX-License-Identifier: MIT

config SHIELD_CORNE_LEFT_CENTRAL
    def_bool $(shields_list_contains,corne_left_central)

config SHIELD_CORNE_LEFT_PERIPHERAL
    def_bool $(shields_list_contains,corne_left_peripheral)

config SHIELD_CORNE_RIGHT_PERIPHERAL 
    def_bool $(shields_list_contains,corne_right_peripheral)

config SHIELD_CORNE_DONGLE_XIAO
    def_bool $(shields_list_contains,corne_dongle_xiao)
    
config SHIELD_CORNE_DONGLE_PRO_MICRO
    def_bool $(shields_list_contains,corne_dongle_pro_micro)
```

## config/boards/arm/nrf52840_mdk_usb_dongle/nrf52840_mdk_usb_dongle_defconfig
```kconfig
# SPDX-License-Identifier: Apache-2.0

CONFIG_SOC_SERIES_NRF52X=y
CONFIG_SOC_NRF52840_QIAA=y
CONFIG_BOARD_NRF52840_MDK_USB_DONGLE=y

# Enable MPU
CONFIG_ARM_MPU=y

# enable uart driver
CONFIG_SERIAL=y

# Console
CONFIG_CONSOLE=y
CONFIG_UART_CONSOLE=y

# Enable hardware stack protection
CONFIG_HW_STACK_PROTECTION=y

# enable GPIO
CONFIG_GPIO=y

# additional board options
CONFIG_GPIO_AS_PINRESET=y

CONFIG_USE_DT_CODE_PARTITION=y

CONFIG_NFCT_PINS_AS_GPIOS=y

CONFIG_BUILD_OUTPUT_UF2=y

CONFIG_MPU_ALLOW_FLASH_WRITE=y
CONFIG_NVS=y
CONFIG_SETTINGS_NVS=y
CONFIG_FLASH=y
CONFIG_FLASH_PAGE_LAYOUT=y
CONFIG_FLASH_MAP=y

CONFIG_PINCTRL=y
```

## config/boards/shields/corne/Kconfig.defconfig
```kconfig
if SHIELD_CORNE_LEFT || SHIELD_CORNE_RIGHT || SHIELD_CORNE_DONGLE || SHIELD_CORNE_CENTRAL
    config ZMK_SPLIT
        default y
    config ZMK_BLE
        default y
    if ZMK_DISPLAY
        config I2C
            default y
        config SSD1306
            default y
    endif # ZMK_DISPLAY
    if LVGL
        config LV_Z_VDB_SIZE
            default 64
        config LV_DPI_DEF
            default 148
        config LV_Z_BITS_PER_PIXEL
            default 1
        choice LV_COLOR_DEPTH
            default LV_COLOR_DEPTH_1
        endchoice
    endif # LVGL
endif

if SHIELD_CORNE_DONGLE
    config ZMK_KEYBOARD_NAME
        default "Infinity Dongle"
    config ZMK_SPLIT_BLE_ROLE_CENTRAL
        default y
    config ZMK_SPLIT_ROLE_CENTRAL
        default y
    config ZMK_USB
        default y
endif

if SHIELD_CORNE_CENTRAL
    config ZMK_KEYBOARD_NAME
        default "Infinity Central"
    config ZMK_SPLIT_BLE_ROLE_CENTRAL
        default y
    config ZMK_SPLIT_ROLE_CENTRAL
        default y
    config ZMK_USB
        default y
#    config USB_DEVICE_ID
#        hex
#        default "0x1D50"
#    config USB_DEVICE_PID
#        hex
#        default "0x615E"
endif

if SHIELD_CORNE_LEFT
    config ZMK_KEYBOARD_NAME
        default "Infinity Left"
   config ZMK_SPLIT_BLE_ROLE_CENTRAL
        default n
   config ZMK_SPLIT_ROLE_CENTRAL
        default n
endif

if SHIELD_CORNE_RIGHT
    config ZMK_KEYBOARD_NAME
        default "Infinity Right"
   config ZMK_SPLIT_BLE_ROLE_CENTRAL
        default n
   config ZMK_SPLIT_ROLE_CENTRAL
        default n
endif

if SHIELD_CORNE_DONGLE_RESET
    config ZMK_KEYBOARD_NAME
        default "Infinity Reset"
endif
```

## config/boards/shields/corne/boards/nrf52840_mdk_usb_dongle.conf
```kconfig
CONFIG_SERIAL=y
CONFIG_CONSOLE=y
CONFIG_UART_CONSOLE=y
CONFIG_UART_LINE_CTRL=y

# USB subsystem configuration
CONFIG_USB_DEVICE_STACK=y
#CONFIG_USB_DEVICE_PRODUCT="Infinity Corne"
CONFIG_USB_DEVICE_INITIALIZE_AT_BOOT=y

CONFIG_BUILD_OUTPUT_UF2=y

CONFIG_MPU_ALLOW_FLASH_WRITE=y
CONFIG_NVS=y
CONFIG_SETTINGS_NVS=y
CONFIG_FLASH=y
CONFIG_FLASH_PAGE_LAYOUT=y
CONFIG_FLASH_MAP=y

CONFIG_ZMK_SETTINGS_RESET_ON_START=y
CONFIG_ZMK_BLE_CLEAR_BONDS_ON_START=y
```

## config/west.yml
```yaml
manifest:
  defaults:
    remote: urob
    revision: v0.3 # Pin everything to v0.1

  remotes:
    - name: zmkfirmware
      url-base: https://github.com/zmkfirmware
    - name: urob
      url-base: https://github.com/urob
    - name: mctechnology17
      url-base: https://github.com/mctechnology17
    - name: carrefinho
      url-base: https://github.com/carrefinho
    # - name: janpfischer
    #   url-base: https://github.com/janpfischer
    - name: m165437
      url-base: https://github.com/M165437

  projects:
    - name: zmk
      remote: zmkfirmware
      revision: v0.3
      # revision: main
      import: app/west.yml

    # ZMK modules
    - name: zmk-adaptive-key
      path: modules/zmk/adaptive-key
    - name: zmk-auto-layer
      path: modules/zmk/auto-layer
    - name: zmk-helpers
      path: modules/zmk/helpers
    - name: zmk-leader-key
      path: modules/zmk/leader-key
    - name: zmk-tri-state
      path: modules/zmk/tri-state
    - name: zmk-unicode
      path: modules/zmk/unicode

    # Nicer visuals on Nice!View and Display
    # nice_epaper support
    - name: zmk-nice-oled
      remote: mctechnology17
      revision: main
    # dongle_display!view
    # - name: zmk-dongle-display-view
    #   remote: mctechnology17
    #   revision: main

    - name: nice-view-gem
      remote: m165437
      revision: v0.3.0

    # Prospector
    - name: prospector-zmk-module
      remote: carrefinho
      revision: main
      # revision: feat/new-status-screens

    # - name: zmk-dongle-screen
    #   remote: janpfischer
    #   revision: main

    # Temporarily overload Zephyr until
    # https://github.com/zmkfirmware/zephyr/pull/40 is merged.
    - name: zephyr
      revision: v3.5.0+zmk-fixes
      remote: zmkfirmware
      # revision: v4.1.0+zmk-fixes
      clone-depth: 1
      import:
        # Only enable most commonly used boards. For less common hardware one
        # may need to enable additional modules.
        name-allowlist:
          - cmsis
          - hal_nordic
          - hal_rpi_pico
          - hal_stm32
          - lvgl
          - mbedtls
          - tinycrypt
          
  self:
    path: config
```
