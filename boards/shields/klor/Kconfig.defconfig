## boards/shields/klor/Kconfig.defconfig
```kconfig
if SHIELD_KLOR_LEFT_CENTRAL || SHIELD_KLOR_DONGLE_PRO_MICRO

    config ZMK_KEYBOARD_NAME
        default "KLOR"

    config ZMK_SPLIT_BLE_ROLE_CENTRAL
        default y

    config ZMK_SPLIT_BLE_CENTRAL_PERIPHERALS
        default 2

    config ZMK_USB
        default y

endif # LEFT_CENTRAL || DONGLE


if SHIELD_KLOR_LEFT_PERIPHERAL || SHIELD_KLOR_RIGHT_PERIPHERAL

    config ZMK_SPLIT_ROLE_CENTRAL
        default n

endif # PERIPHERAL


if SHIELD_KLOR_LEFT_PERIPHERAL || SHIELD_KLOR_RIGHT_PERIPHERAL || SHIELD_KLOR_LEFT_CENTRAL || SHIELD_KLOR_DONGLE_PRO_MICRO

    config ZMK_SPLIT
        default y

    config ZMK_BLE
        default y

    if ZMK_DISPLAY

        config I2C
            default y

        config SSD1306
            default y

    endif # ZMK_DISPLAY



    if LVGL

        config LV_Z_VDB_SIZE
            default 64

        config LV_DPI_DEF
            default 148

        config LV_Z_BITS_PER_PIXEL
            default 1

        choice LV_COLOR_DEPTH
            default LV_COLOR_DEPTH_1
        endchoice

    endif # LVGL


endif # LEFT RIGHT DONGLE
```

## boards/shields/klor/Kconfig.shield
```kconfig
config SHIELD_KLOR_LEFT_CENTRAL
    def_bool $(shields_list_contains,klor_left_central)

config SHIELD_KLOR_LEFT_PERIPHERAL
    def_bool $(shields_list_contains,klor_left_peripheral)
    
config SHIELD_KLOR_RIGHT_PERIPHERAL
    def_bool $(shields_list_contains,klor_right_peripheral)

config SHIELD_KLOR_DONGLE_PRO_MICRO
    def_bool $(shields_list_contains,klor_dongle_pro_micro)
```
